// SPDX-License-Identifier: AGPL-3.0-or-later
#include "WebServer.h"
#include <AsyncJson.h>
#include <ArduinoJson.h>
#include "config.h"
#include "web_assets.h" // generated by scripts/embed_assets.py

// ---- helpers --------------------------------------------------------------

static void sendJson(AsyncWebServerRequest *req, int code, JsonDocument &doc) {
  auto *res = req->beginResponseStream("application/json");
  res->setCode(code);
  serializeJson(doc, *res);
  req->send(res);
}

static void sendOk(AsyncWebServerRequest *req, bool reboot = false) {
  JsonDocument doc;
  doc["ok"] = true;
  if (reboot) doc["reboot"] = true;
  sendJson(req, 200, doc);
}

static const WebAsset *findAsset(const String &path) {
  String p = (path == "/") ? "/index.html" : path;
  for (unsigned i = 0; i < WEB_ASSETS_COUNT; i++) {
    if (p == WEB_ASSETS[i].path) return &WEB_ASSETS[i];
  }
  return nullptr;
}

static void serveAsset(AsyncWebServerRequest *req, const WebAsset *a) {
  auto *res = req->beginResponse(200, a->type, a->data, a->len);
  if (a->gzip) res->addHeader("Content-Encoding", "gzip");
  req->send(res);
}

// ---- lifecycle ------------------------------------------------------------

void WebServer::begin(AppConfig &cfg, ViscaSerial &serial, NetLink &net,
                      ViscaProxy &proxy, bool captive) {
  _cfg = &cfg;
  _serial = &serial;
  _net = &net;
  _proxy = &proxy;
  _captive = captive;

  registerApi();
  registerAssets();
  _server.begin();
  log_i("Web server started");
}

ViscaFrame WebServer::runCommand(const ViscaFrame &frame, bool wantReply) {
  ViscaFrame reply;
  if (!_serial->lock()) return reply;
  _serial->write(frame);
  // Always drain the camera's ACK/completion so it can't bleed into a later
  // proxy reply; return the bytes only when the caller wants them.
  uint32_t first = wantReply ? VISCA_SERIAL_TIMEOUT_MS : 200;
  bool isFirst = true;
  while (true) {
    ViscaFrame f = _serial->readReply(isFirst ? first : 120);
    if (f.empty()) break;
    if (wantReply) reply.insert(reply.end(), f.begin(), f.end());
    isFirst = false;
    if (f.size() >= 2 && (f[1] & 0xF0) == 0x50) break; // completion
  }
  _serial->unlock();
  return reply;
}

// ---- static assets --------------------------------------------------------

void WebServer::registerAssets() {
  _server.on("/", HTTP_GET, [](AsyncWebServerRequest *req) {
    const WebAsset *a = findAsset("/");
    if (a) serveAsset(req, a);
    else req->send(404);
  });

  _server.onNotFound([this](AsyncWebServerRequest *req) {
    const WebAsset *a = findAsset(req->url());
    if (a) {
      serveAsset(req, a);
      return;
    }
    // Captive portal / SPA fallback: hand back the app shell.
    const WebAsset *idx = findAsset("/");
    if (idx) serveAsset(req, idx);
    else req->send(404);
  });
}

// ---- JSON API -------------------------------------------------------------

void WebServer::registerApi() {
  // Status
  _server.on("/api/status", HTTP_GET, [this](AsyncWebServerRequest *req) {
    JsonDocument doc;
    doc["name"] = FW_NAME;
    doc["fw"] = FW_VERSION;
    doc["source"] = SOURCE_URL; // AGPL-3.0 §13 source offer
    doc["link"] = _net->linkName();
    doc["ip"] = _net->localIP().toString();
    doc["captive"] = _captive;
    doc["uptime"] = (uint32_t)(millis() / 1000);
    doc["heap"] = ESP.getFreeHeap();
    JsonObject v = doc["visca"].to<JsonObject>();
    v["port"] = _cfg->viscaPort;
    v["address"] = _cfg->viscaAddress;
    v["in"] = _proxy->packetsIn();
    v["out"] = _proxy->packetsOut();
    sendJson(req, 200, doc);
  });

  // Get config (secrets omitted; flags indicate whether they are set)
  _server.on("/api/config", HTTP_GET, [this](AsyncWebServerRequest *req) {
    JsonDocument doc;
    doc["hostname"] = _cfg->hostname;
    doc["wifiSsid"] = _cfg->wifiSsid;
    doc["hasWifiPass"] = _cfg->wifiPass.length() > 0;
    doc["ethEnabled"] = _cfg->ethEnabled;
    doc["ethSck"] = _cfg->ethSck;
    doc["ethMiso"] = _cfg->ethMiso;
    doc["ethMosi"] = _cfg->ethMosi;
    doc["ethCs"] = _cfg->ethCs;
    doc["ethInt"] = _cfg->ethInt;
    doc["ethRst"] = _cfg->ethRst;
    doc["uartTx"] = _cfg->uartTx;
    doc["uartRx"] = _cfg->uartRx;
    doc["serialBaud"] = _cfg->serialBaud;
    doc["viscaPort"] = _cfg->viscaPort;
    doc["viscaAddress"] = _cfg->viscaAddress;
    doc["apSsid"] = _cfg->apSsid;
    doc["hasApPass"] = _cfg->apPass.length() > 0;
    doc["hasOtaPass"] = _cfg->otaPassword.length() > 0;
    doc["statusLedPin"] = _cfg->statusLedPin;
    doc["statusLedActiveLow"] = _cfg->statusLedActiveLow;
    sendJson(req, 200, doc);
  });

  // Save config
  auto *cfgHandler = new AsyncCallbackJsonWebHandler(
      "/api/config", [this](AsyncWebServerRequest *req, JsonVariant &json) {
        JsonObject o = json.as<JsonObject>();
        AppConfig &c = *_cfg;
        if (o["hostname"].is<const char *>()) c.hostname = o["hostname"].as<String>();
        if (o["wifiSsid"].is<const char *>()) c.wifiSsid = o["wifiSsid"].as<String>();
        if (o["wifiPass"].is<const char *>() && o["wifiPass"].as<String>().length())
          c.wifiPass = o["wifiPass"].as<String>();
        if (o["ethEnabled"].is<bool>()) c.ethEnabled = o["ethEnabled"];
        if (o["ethSck"].is<int>()) c.ethSck = o["ethSck"];
        if (o["ethMiso"].is<int>()) c.ethMiso = o["ethMiso"];
        if (o["ethMosi"].is<int>()) c.ethMosi = o["ethMosi"];
        if (o["ethCs"].is<int>()) c.ethCs = o["ethCs"];
        if (o["ethInt"].is<int>()) c.ethInt = o["ethInt"];
        if (o["ethRst"].is<int>()) c.ethRst = o["ethRst"];
        if (o["uartTx"].is<int>()) c.uartTx = o["uartTx"];
        if (o["uartRx"].is<int>()) c.uartRx = o["uartRx"];
        if (o["serialBaud"].is<uint32_t>()) c.serialBaud = o["serialBaud"];
        if (o["viscaPort"].is<uint16_t>()) c.viscaPort = o["viscaPort"];
        if (o["viscaAddress"].is<uint8_t>()) c.viscaAddress = o["viscaAddress"];
        if (o["apSsid"].is<const char *>()) c.apSsid = o["apSsid"].as<String>();
        if (o["apPass"].is<const char *>() && o["apPass"].as<String>().length())
          c.apPass = o["apPass"].as<String>();
        if (o["otaPassword"].is<const char *>() && o["otaPassword"].as<String>().length())
          c.otaPassword = o["otaPassword"].as<String>();
        if (o["statusLedPin"].is<int>()) c.statusLedPin = o["statusLedPin"];
        if (o["statusLedActiveLow"].is<bool>()) c.statusLedActiveLow = o["statusLedActiveLow"];
        c.save();
        sendOk(req, /*reboot=*/true);
      });
  _server.addHandler(cfgHandler);

  // PTZ control
  auto *ptzHandler = new AsyncCallbackJsonWebHandler(
      "/api/ptz", [this](AsyncWebServerRequest *req, JsonVariant &json) {
        JsonObject o = json.as<JsonObject>();
        String action = o["action"] | "";
        uint8_t addr = _cfg->viscaAddress;
        ViscaFrame f;
        if (action == "move") {
          String pd = o["pan"] | "none";
          String td = o["tilt"] | "none";
          uint8_t ps = o["panSpeed"] | 8;
          uint8_t ts = o["tiltSpeed"] | 8;
          ViscaCmd::Pan pan = pd == "left" ? ViscaCmd::Pan::Left
                              : pd == "right" ? ViscaCmd::Pan::Right
                                              : ViscaCmd::Pan::None;
          ViscaCmd::Tilt tilt = td == "up" ? ViscaCmd::Tilt::Up
                                : td == "down" ? ViscaCmd::Tilt::Down
                                               : ViscaCmd::Tilt::None;
          f = ViscaCmd::panTilt(addr, pan, tilt, ps, ts);
        } else if (action == "stop") {
          f = ViscaCmd::panTiltStop(addr);
        } else if (action == "home") {
          f = ViscaCmd::home(addr);
        } else if (action == "zoom") {
          String d = o["dir"] | "stop";
          uint8_t sp = o["speed"] | 4;
          int8_t dir = d == "tele" ? 1 : d == "wide" ? -1 : 0;
          f = ViscaCmd::zoom(addr, dir, sp);
        } else if (action == "focus") {
          if (o["auto"].is<bool>()) {
            f = ViscaCmd::focusAuto(addr, o["auto"]);
          } else {
            String d = o["dir"] | "stop";
            int8_t dir = d == "far" ? 1 : d == "near" ? -1 : 0;
            f = ViscaCmd::focus(addr, dir);
          }
        } else if (action == "power") {
          f = ViscaCmd::power(addr, o["on"] | false);
        } else {
          req->send(400, "application/json", "{\"error\":\"bad action\"}");
          return;
        }
        runCommand(f, false);
        sendOk(req);
      });
  _server.addHandler(ptzHandler);

  // Presets
  auto *presetHandler = new AsyncCallbackJsonWebHandler(
      "/api/preset", [this](AsyncWebServerRequest *req, JsonVariant &json) {
        JsonObject o = json.as<JsonObject>();
        String op = o["op"] | "";
        uint8_t id = o["id"] | 0;
        uint8_t addr = _cfg->viscaAddress;
        ViscaFrame f;
        if (op == "set") f = ViscaCmd::presetSet(addr, id);
        else if (op == "recall") f = ViscaCmd::presetRecall(addr, id);
        else {
          req->send(400, "application/json", "{\"error\":\"bad op\"}");
          return;
        }
        runCommand(f, false);
        sendOk(req);
      });
  _server.addHandler(presetHandler);

  // Raw VISCA passthrough (returns the reply as hex)
  auto *rawHandler = new AsyncCallbackJsonWebHandler(
      "/api/visca/raw", [this](AsyncWebServerRequest *req, JsonVariant &json) {
        JsonObject o = json.as<JsonObject>();
        String hex = o["hex"] | "";
        ViscaFrame f = hexToBytes(hex);
        if (f.empty()) {
          req->send(400, "application/json", "{\"error\":\"empty/invalid hex\"}");
          return;
        }
        ViscaFrame reply = runCommand(f, true);
        JsonDocument doc;
        doc["ok"] = true;
        doc["reply"] = bytesToHex(reply.data(), reply.size());
        sendJson(req, 200, doc);
      });
  _server.addHandler(rawHandler);

  // Reboot
  _server.on("/api/reboot", HTTP_POST, [](AsyncWebServerRequest *req) {
    sendOk(req);
    delay(200);
    ESP.restart();
  });

  // Factory reset
  _server.on("/api/factory-reset", HTTP_POST, [](AsyncWebServerRequest *req) {
    AppConfig::reset();
    sendOk(req);
    delay(200);
    ESP.restart();
  });
}